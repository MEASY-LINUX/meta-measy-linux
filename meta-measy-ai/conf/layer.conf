## meta-measy-ai/conf/layer.conf
```bitbake
# Copyright (C) 2026 MYIR Tech Limited
# SPDX-License-Identifier: MIT

BBPATH .= ":${LAYERDIR}"

BBFILES += "${LAYERDIR}/recipes-*/*/*.bb \
            ${LAYERDIR}/recipes-*/*/*.bbappend"

BBFILE_COLLECTIONS += "measy-ai"
BBFILE_PATTERN_measy-ai = "^${LAYERDIR}/"
BBFILE_PRIORITY_measy-ai = "6"

LAYERVERSION_measy-ai = "1"
LAYERSERIES_COMPAT_measy-ai = "wrynose"
LAYERDEPENDS_measy-ai = "core"
```
